## conf/layer.conf
```bitbake
# We have a conf and classes directory, add to BBPATH
BBPATH .= ":${LAYERDIR}"

# We have recipes-* directories, add to BBFILES
BBFILES += "${LAYERDIR}/recipes-*/*/*.bb ${LAYERDIR}/recipes-*/*/*.bbappend"

BBFILE_COLLECTIONS += "beaglebone"
BBFILE_PATTERN_beaglebone = "^${LAYERDIR}/"
BBFILE_PRIORITY_beaglebone = "6"

# This should only be incremented on significant changes that will
# cause compatibility issues with other layers
LAYERVERSION_beaglebone = "1"

LAYERDEPENDS_beaglebone = "core"
```
